## samples/bluetooth/peripheral_rscs/Kconfig.sysbuild
```kconfig
#
# Copyright (c) 2023 Nordic Semiconductor
#
# SPDX-License-Identifier: LicenseRef-Nordic-5-Clause
#

source "${ZEPHYR_BASE}/share/sysbuild/Kconfig"

config NRF_DEFAULT_BLUETOOTH
	default y

SB_CONFIG_NETCORE_REMOTE_BOARD_NAME="nrf54h20dk_nrf54h20_cpurad"
SB_CONFIG_SUPPORT_NETCORE=y
```
